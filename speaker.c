//===============================================================================
//	Speaker.c
//===============================================================================

#include <avr/io.h>
#include <avr/interrupt.h>
#include <stdio.h>

// #define		_MAIN

#define		EX_LED		(*(volatile unsigned char*) 0x8008)

extern void		initDevies(void);

extern unsigned char	musicKey;
extern unsigned char	autoPlay;

void	playPiano(void);

#ifdef		_MAIN
int
main(void)
{
	initDevices();
	while(1);
}
#endif

static unsigned char		musicScore[] = {
	0x44, 0x54, 0x44, 0x34, 0x24, 0x34, 0x48, 0x14, 0x24, 0x38, 0x24, 0x34, 0x48,
	0x44, 0x54, 0x44, 0x34, 0x24, 0x34, 0x48, 0x18, 0x48, 0x24, 0x04, 0x04, 0xb4,
	0x44, 0x54, 0x44, 0x34, 0x24, 0x34, 0x48, 0x14, 0x24, 0x38, 0x24, 0x34, 0x48,
	0x44, 0x54, 0x44, 0x34, 0x24, 0x34, 0x48, 0x18, 0x48, 0x24, 0x04, 0x04, 0xb4,
	0x44, 0x54, 0x44, 0x34, 0x24, 0x34, 0x48, 0x14, 0x24, 0x38, 0x24, 0x34, 0x48,
	0x44, 0x54, 0x44, 0x34, 0x24, 0x34, 0x48, 0x18, 0x48, 0x24, 0x04, 0x04, 0xb4
	};

static unsigned char		musicNote = 0;				//음표를 가르킨다.
static unsigned int		noteLength = 0;				//음의 길이를 나타냄, 0일 때 다음 음표로 넘어감

void
playMusic(void)
{
	if(PINB & 0x01)						//0x01 스위치를 누르면 수동 연주
		{autoPlay = 0;  }
	else if(noteLength > 0) noteLength--;				//현재 연주되는 음표길이 소진여부 확인
	else if(musicNote < 100) {
		musicKey = musicScore[musicNote] >> 4;		//현재 가르키고 있는 음표의 상위 4bit 득
		noteLength = 100 * (musicScore[musicNote] & 0x0f);	//현재 가르키고 있는 음표의 하위 4bit 득
		musicNote++;
	} else
		musicKey = 200;					//연주 끝
}
