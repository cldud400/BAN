//===============================================================================
//	DotMatrix.c
//===============================================================================

#include <avr/io.h>
#include <avr/interrupt.h>
#include <stdio.h>

//#define		_MAIN

extern void	initDevies(void);
extern int fnd;

extern short	*dotMatrixData;			//포인터로 가해진 연산은 전부 page에 가해진다

static unsigned char		dotMatrixPage = 1;
//첫번째 index는 page, 두번째 index는 page안의 각 행 선택
static short		page[5][10] = { 
	{ 0x000,  0x010,  0x038,  0x038,  0x03c,  0x0bc,  0x0fc,  0x0fc,  0x07c,  0x038 },	
	{ 0x120,  0x170,  0x120,  0x160,  0x1a0,  0x1e0,  0x120,  0x150,  0x150,  0x150 },
	{ 0x140,  0x1e0,  0x140,  0x140,  0x1e0,  0x1c0,  0x140,  0x120,  0x120,  0x120 },
	{ 0x100,  0x120,  0x170,  0x120,  0x140,  0x1c0,  0x1c0,  0x160,  0x130,  0x150 },
	{ 0x303,  0x186,  0x0cc,  0x078,  0x030,  0x078,  0x0cc,  0x186,  0x303,  0x201 }
	};

static short		page11[11][10] = { 
	{0x3ff,0x3ff,0x3ff,0x3b7,0x3b7,0x3b7,0x3ff,0x3ff,0x3ff,0x3ff },	
	{0x3cf,0x3cf,0x3cf,0x34b,0x34b,0x34b,0x3cf,0x3cf,0x3cf,0x3cf },
	{0x387,0x387,0x387,0x285,0x285,0x285,0x387,0x387,0x387,0x387 },
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	{0x3ff,0x3ff,0x3ff,0x3b7,0x3b7,0x3b7,0x3ff,0x3ff,0x3ff,0x3ff },
	};


#ifdef		_MAIN
int
main(void)
{
	dotMatrixData = page[0];
	initDevices();
	while(1);
}
#endif

void
turnDotMatrixPage(void)
{
	if(fnd==0){
	dotMatrixData = page[dotMatrixPage];
	dotMatrixPage++;
	dotMatrixPage %= 5;
	}
	if(fnd==1){
	dotMatrixData = page11[dotMatrixPage];
	dotMatrixPage++;
	dotMatrixPage %= 11;
	}

}
